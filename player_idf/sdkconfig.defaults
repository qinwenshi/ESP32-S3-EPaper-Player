## player_idf/sdkconfig.defaults
```kconfig
# Flash / RAM
CONFIG_ESPTOOLPY_FLASHSIZE_8MB=y
CONFIG_ESPTOOLPY_FLASHMODE_QIO=y
CONFIG_ESPTOOLPY_FLASHFREQ_80M=y

# PSRAM (OPI/Octal 8MB)
CONFIG_SPIRAM=y
CONFIG_SPIRAM_MODE_OCT=y
CONFIG_SPIRAM_SPEED_80M=y
CONFIG_SPIRAM_USE_MALLOC=y
CONFIG_SPIRAM_MALLOC_ALWAYSINTERNAL=4096
CONFIG_SPIRAM_ALLOW_STACK_EXTERNAL_MEMORY=y

# Partition table
CONFIG_PARTITION_TABLE_CUSTOM=y
CONFIG_PARTITION_TABLE_CUSTOM_FILENAME="partitions.csv"

# CPU
CONFIG_ESP_DEFAULT_CPU_FREQ_MHZ_240=y

# USB CDC (HWCDC — same as Arduino build)
CONFIG_ESP_CONSOLE_USB_CDC=y
CONFIG_ESP_CONSOLE_SECONDARY_NONE=y

# FreeRTOS
CONFIG_FREERTOS_HZ=1000
CONFIG_FREERTOS_UNICORE=n

# Main task stack (app_main runs here — needs space for LVGL init, SD scan, etc.)
CONFIG_ESP_MAIN_TASK_STACK_SIZE=32768

# Log
CONFIG_LOG_DEFAULT_LEVEL_INFO=y

# C++ exceptions
CONFIG_COMPILER_CXX_EXCEPTIONS=y

# LVGL via component manager needs this
CONFIG_LV_CONF_SKIP=n

# I2S
CONFIG_I2S_ENABLE_DEBUG_LOG=n

# SDMMC
CONFIG_SDMMC_IO_POWER_DOMAIN_DEFAULT=n

# NVS encryption off
CONFIG_NVS_ENCRYPTION=n
```
